## jslinux/buildroot/Config.in
```kconfig
menu "Linux troubleshooting lab"

source "$BR2_EXTERNAL_LAB_PATH/package/endpoint3-js/Config.in"
source "$BR2_EXTERNAL_LAB_PATH/package/lab-endpoints/Config.in"

endmenu
```

## jslinux/buildroot/configs/lab_database_x86_64_defconfig
```kconfig
BR2_x86_64=y
BR2_TOOLCHAIN_BUILDROOT_MUSL=y
BR2_KERNEL_HEADERS_6_12=y
BR2_TOOLCHAIN_BUILDROOT_CXX=y
BR2_INIT_BUSYBOX=y
BR2_TARGET_GENERIC_HOSTNAME="linux-db-lab"
BR2_TARGET_GENERIC_ISSUE="Linux database troubleshooting lab"
BR2_TARGET_GENERIC_GETTY_PORT="hvc0"
BR2_TARGET_GENERIC_ROOT_PASSWD=""
BR2_ROOTFS_OVERLAY="$(BR2_EXTERNAL_LAB_PATH)/board/lab/rootfs-overlay $(BR2_EXTERNAL_LAB_PATH)/board/lab/rootfs-database-overlay"
BR2_PACKAGE_BUSYBOX_SHOW_OTHERS=y
BR2_PACKAGE_BASH=y
BR2_PACKAGE_LIBCURL=y
BR2_PACKAGE_LIBCURL_CURL=y
BR2_PACKAGE_FILE=y
BR2_PACKAGE_FINDUTILS=y
BR2_PACKAGE_GREP=y
BR2_PACKAGE_IPROUTE2=y
BR2_PACKAGE_LESS=y
BR2_PACKAGE_LSOF=y
BR2_PACKAGE_MARIADB=y
BR2_PACKAGE_MARIADB_SERVER=y
BR2_PACKAGE_NANO=y
BR2_PACKAGE_NGINX=y
BR2_PACKAGE_NGINX_HTTP=y
BR2_PACKAGE_NGINX_HTTP_PROXY_MODULE=y
BR2_PACKAGE_PROCPS_NG=y
BR2_PACKAGE_SED=y
BR2_PACKAGE_STRACE=y
BR2_PACKAGE_DATABASE_CHALLENGE=y
BR2_TARGET_ROOTFS_EXT2=y
BR2_TARGET_ROOTFS_EXT2_2=y
BR2_TARGET_ROOTFS_EXT2_SIZE="512M"
# BR2_TARGET_ROOTFS_TAR is not set
```

## jslinux/buildroot/configs/lab_x86_64_defconfig
```kconfig
BR2_x86_64=y
BR2_TOOLCHAIN_BUILDROOT_MUSL=y
BR2_KERNEL_HEADERS_6_12=y
BR2_INIT_BUSYBOX=y
BR2_TARGET_GENERIC_HOSTNAME="linux-lab"
BR2_TARGET_GENERIC_ISSUE="Linux troubleshooting lab"
BR2_TARGET_GENERIC_GETTY_PORT="hvc0"
BR2_TARGET_GENERIC_ROOT_PASSWD=""
BR2_ROOTFS_OVERLAY="$(BR2_EXTERNAL_LAB_PATH)/board/lab/rootfs-overlay"
BR2_PACKAGE_BUSYBOX_SHOW_OTHERS=y
BR2_PACKAGE_BASH=y
BR2_PACKAGE_LIBCURL=y
BR2_PACKAGE_LIBCURL_CURL=y
BR2_PACKAGE_FILE=y
BR2_PACKAGE_FINDUTILS=y
BR2_PACKAGE_GREP=y
BR2_PACKAGE_IPROUTE2=y
BR2_PACKAGE_LESS=y
BR2_PACKAGE_LSOF=y
BR2_PACKAGE_NANO=y
BR2_PACKAGE_NGINX=y
BR2_PACKAGE_NGINX_HTTP=y
BR2_PACKAGE_NGINX_HTTP_PROXY_MODULE=y
BR2_PACKAGE_PROCPS_NG=y
BR2_PACKAGE_SED=y
BR2_PACKAGE_STRACE=y
BR2_PACKAGE_ENDPOINT3_JS=y
BR2_PACKAGE_LAB_ENDPOINTS=y
BR2_TARGET_ROOTFS_EXT2=y
BR2_TARGET_ROOTFS_EXT2_2=y
BR2_TARGET_ROOTFS_EXT2_SIZE="192M"
# BR2_TARGET_ROOTFS_TAR is not set
```

## jslinux/buildroot/package/database-challenge/Config.in
```kconfig
config BR2_PACKAGE_DATABASE_CHALLENGE
	bool "database-challenge"
	depends on BR2_PACKAGE_MARIADB_SERVER
	help
	  HTTP service for the browser-hosted MariaDB troubleshooting
	  challenge.
```

## jslinux/buildroot/package/endpoint3-js/Config.in
```kconfig
config BR2_PACKAGE_ENDPOINT3_JS
	bool "endpoint3-js"
	help
	  Minimal HTTP service for the maintenance lock-file puzzle.
```

## jslinux/buildroot/package/lab-endpoints/Config.in
```kconfig
config BR2_PACKAGE_LAB_ENDPOINTS
	bool "lab-endpoints"
	help
	  Native services for browser-hosted troubleshooting challenges
	  1, 2, and 4.
```
